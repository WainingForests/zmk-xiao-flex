## config/boards/shields/dactyl_cc/Kconfig.defconfig
```kconfig
if SHIELD_DACTYL_CC_LEFT

config ZMK_KEYBOARD_NAME
    default "dactyl_cc"

config ZMK_SPLIT_ROLE_CENTRAL
    default y

endif

if SHIELD_DACTYL_CC

config ZMK_SPLIT
    default y

endif
```

## config/boards/shields/dactyl_cc/Kconfig.shield
```kconfig
config SHIELD_DACTYL_CC
    bool

config SHIELD_DACTYL_CC_LEFT
    def_bool $(shields_list_contains,dactyl_cc_left)
    select SHIELD_DACTYL_CC

config SHIELD_DACTYL_CC_RIGHT
    def_bool $(shields_list_contains,dactyl_cc_right)
    select SHIELD_DACTYL_CC
```
